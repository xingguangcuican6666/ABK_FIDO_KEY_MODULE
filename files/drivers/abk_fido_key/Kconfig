## files/drivers/abk_fido_key/Kconfig
```kconfig
config ABK_FIDO_KEY
	bool "ABK FIDO2 USB Security Key"
	depends on USB_GADGET
	select CRYPTO
	select CRYPTO_ECC
	select CRYPTO_HMAC
	select CRYPTO_SHA256
	select CRYPTO_AES
	select CRYPTO_CBC
	select CRYPTO_SKCIPHER
	select CRYPTO_KPP
	select CRYPTO_ECDH
	help
	  Add a kernel-integrated FIDO2 HID authenticator that is injected
	  into the active Android USB configfs gadget as an extra HID
	  interface. The implementation exposes a /dev/hidgX debug endpoint
	  and attempts to load authenticator state from
	  /metadata/abk_fido_store.bin.

config ABK_FIDO_KEY_CTAP2
	bool "Enable CTAP2 core"
	depends on ABK_FIDO_KEY
	default y

config ABK_FIDO_KEY_GADGET_AUTO_ATTACH
	bool "Automatically attach FIDO HID function to configfs gadget"
	depends on ABK_FIDO_KEY
	default y

config ABK_FIDO_KEY_PERSIST_METADATA
	bool "Persist FIDO store under /metadata"
	depends on ABK_FIDO_KEY
	default y

config ABK_FIDO_KEY_PERSIST_ADB_DATA
	bool "Deprecated compatibility toggle for metadata persistence"
	depends on ABK_FIDO_KEY
	default y
	help
	  Compatibility symbol kept so older ABK defconfigs continue to enable
	  FIDO persistence after the storage backend moved from /data/adb to
	  /metadata.
```
